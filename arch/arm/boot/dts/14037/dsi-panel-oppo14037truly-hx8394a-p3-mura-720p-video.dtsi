/* Copyright (c) 2013, The Linux Foundation. All rights reserved.
 *
 * This program is free software; you can redistribute it and/or modify
 * it under the terms of the GNU General Public License version 2 and
 * only version 2 as published by the Free Software Foundation.
 *
 * This program is distributed in the hope that it will be useful,
 * but WITHOUT ANY WARRANTY; without even the implied warranty of
 * MERCHANTABILITY or FITNESS FOR A PARTICULAR PURPOSE.  See the
 * GNU General Public License for more details.
 */

/*---------------------------------------------------------------------------
 * This file is autogenerated file using gcdb parser. Please do not edit it.
 * Update input XML file to add a new entry or update variable in this file
 * VERSION = "1.0"
 *---------------------------------------------------------------------------*/
&mdss_mdp {
	dsi_oppo14037truly_hx8394a_p3_mura_720p_video: qcom,mdss_dsi_oppo14037truly_hx8394a_p3_mura_720p_video {
		qcom,mdss-dsi-panel-name = "oppo14037truly hx8394a p3 mura 720p video mode dsi panel";
		qcom,mdss-dsi-panel-manufacture = "Truly_p3_mura";
		qcom,mdss-dsi-panel-version = "HX8394A";
		qcom,mdss-dsi-panel-controller = <&mdss_dsi0>;
		qcom,mdss-dsi-panel-type = "dsi_video_mode";
		qcom,mdss-dsi-panel-destination = "display_1";
		qcom,mdss-dsi-panel-framerate = <58>;
		qcom,mdss-dsi-virtual-channel-id = <0>;
		qcom,mdss-dsi-stream = <0>;
		qcom,mdss-dsi-panel-width = <720>;
		qcom,mdss-dsi-panel-height = <1280>;
		qcom,mdss-dsi-h-front-porch = <144>;
		qcom,mdss-dsi-h-back-porch = <60>;
		qcom,mdss-dsi-h-pulse-width = <60>;
		qcom,mdss-dsi-h-sync-skew = <0>;
		qcom,mdss-dsi-v-back-porch = <8>;
		qcom,mdss-dsi-v-front-porch = <7>;
		qcom,mdss-dsi-v-pulse-width = <2>;
		qcom,mdss-dsi-h-left-border = <0>;
		qcom,mdss-dsi-h-right-border = <0>;
		qcom,mdss-dsi-v-top-border = <0>;
		qcom,mdss-dsi-v-bottom-border = <0>;
		qcom,mdss-dsi-bpp = <24>;
		qcom,mdss-dsi-color-order = <0>;
		qcom,mdss-dsi-underflow-color = <0xff>;
		qcom,mdss-dsi-border-color = <0>;
		qcom,mdss-dsi-on-command = [39 01 00 00 00 00 04 B9 FF 83 94
			39 01 00 00 00 00 02 BA 13
			39 01 00 00 00 00 11 B1 01 00 47 86 01 0E 0E 2F 37 3F 3F 47 12 01 E6 E2
			39 01 00 00 00 00 07 B2 00 C8 08 04 00 22
			39 01 00 00 00 00 17 B4 80 06 32 10 03 32 15 08 32 10 08 33 04 43 05 37 04 43 06 61 61 06
			39 01 00 00 00 00 05 BF 06 02 10 04
			39 01 00 00 00 00 03 C0 0C 15
			39 01 00 00 00 00 02 B6 F2	/*VCOM=-2.2V*/
			39 01 00 00 00 00 05 C7 00 10 00 10
			39 01 00 00 00 00 04 C6 08 08 80
			39 01 00 00 00 00 02 CC 09
			39 01 00 00 00 00 21 D5 00 00 00 00 0A 00 01 00 CC 00 00 00 88 88 88 88 88 88 88 88 88 88 01 67 45 23 01 23 88 88 88 88
			39 01 00 00 00 00 2B E0 00 03 06 2B 33 3F 10 34 04 0b 0D 11 13 11 13 10 17 00 03 06 2B 33 3F 10 34 04 0b 0d 11 13 11 13 10 17 0b 17 07 11 0B 17 07 11
			39 01 00 00 00 00 2D C1 01 00 0A 11 18 20 28 30 38 40 47 4F 56 5E 65 6E 76 7F 87 8F 97 9E A6 AE B6 BE C7 CF D8 E0 E7 EF F8 FF 06 95 57 BA 51 C2 6E 38 C0 00
			29 01 00 00 00 00 2D C1 09 10 16 1D 24 2B 32 39 40 47 4E 55 5C 62 6A 71 79 81 87 8E 96 9D A4 AA B2 B9 C0 C8 D0 D7 DE E5 11 29 F5 4D 92 80 C7 EF C0 00 0A 11
			29 01 00 00 00 00 28 C1 18 20 28 30 38 40 47 4F 56 5E 65 6E 76 7F 87 8F 97 9E A6 AE B6 BE C7 CF D8 E0 E7 EF F8 FF 06 95 57 BA 51 C2 6E 38 C0  
			39 01 00 00 00 00 02 D4 32
			39 01 00 00 00 00 02 35 00
			39 01 00 00 96 00 02 11 00
			39 01 00 00 14 00 02 29 00
			39 01 00 00 10 00 03 E4 42 00
			39 01 00 00 10 00 1F E5 00 03 08 03 02 00 20 20 00 00 00 00 08 06 04 00 80 0e 20 07 03 02 03 03 03 03 03 03 02 01
			39 01 00 00 10 00 12 E6 40 08 00 05 05 10 20 02 08 10 08 08 08 08 10 10 08];
		qcom,mdss-dsi-off-command = [05 01 00 00 32 00 02 28 00
					05 01 00 00 78 00 02 10 00];
		qcom,mdss-dsi-on-command-state = "dsi_lp_mode";
		qcom,mdss-dsi-off-command-state = "dsi_hs_mode";
		qcom,mdss-dsi-panel-status-command = [06 01 00 01 05 00 02 09 08];
		qcom,mdss-dsi-panel-status-command-state = "dsi_lp_mode";
		qcom,mdss-dsi-panel-status-check-mode = "reg_read";
		qcom,mdss-dsi-panel-status-value = <0x80>;
		/*qcom,mdss-dsi-tx-eot-append;*/
		qcom,mdss-dsi-h-sync-pulse = <1>;
		qcom,mdss-dsi-traffic-mode = "burst_mode";
		qcom,mdss-dsi-lane-map = <0>;
		qcom,mdss-dsi-bllp-eof-power-mode;
		qcom,mdss-dsi-bllp-power-mode;
		qcom,mdss-dsi-lane-0-state;
		qcom,mdss-dsi-lane-1-state;
		qcom,mdss-dsi-lane-2-state;
		qcom,mdss-dsi-lane-3-state;
		qcom,mdss-dsi-panel-timings = [7F 1C 12 00 40 44 16 1E 17 03 04 00];
		qcom,mdss-dsi-t-clk-post = <0x04>;
		qcom,mdss-dsi-t-clk-pre = <0x1B>;
		qcom,mdss-dsi-bl-min-level = <1>;
		qcom,mdss-dsi-bl-max-level = <255>;
		qcom,mdss-dsi-dma-trigger = <4>;
		qcom,mdss-dsi-mdp-trigger = <0>;
		qcom,mdss-dsi-bl-pmic-control-type = "bl_ctrl_wled";
		qcom,mdss-dsi-reset-sequence = <1 10>, <0 10>, <1 60>;
		qcom,mdss-pan-physical-width-dimension = <58>;
		qcom,mdss-pan-physical-height-dimension = <103>;
		qcom,mdss-dsi-lp11-init = <1>;

	};
};
