/* Copyright (c) 2013, The Linux Foundation. All rights reserved.
 *
 * This program is free software; you can redistribute it and/or modify
 * it under the terms of the GNU General Public License version 2 and
 * only version 2 as published by the Free Software Foundation.
 *
 * This program is distributed in the hope that it will be useful,
 * but WITHOUT ANY WARRANTY; without even the implied warranty of
 * MERCHANTABILITY or FITNESS FOR A PARTICULAR PURPOSE.  See the
 * GNU General Public License for more details.
 */

/*---------------------------------------------------------------------------
 * This file is autogenerated file using gcdb parser. Please do not edit it.
 * Update input XML file to add a new entry or update variable in this file
 * VERSION = "1.0"
 *---------------------------------------------------------------------------*/
&mdss_mdp {
	dsi_oppo15005truly_fwvga_video: qcom,mdss_dsi_oppo15005truly_fwvga_video {
		qcom,mdss-dsi-panel-name = "oppo15005truly fwvga video mode dsi panel";
		qcom,mdss-dsi-panel-manufacture = "Truly";
		qcom,mdss-dsi-panel-version = "HX8379c";
		qcom,mdss-dsi-panel-controller = <&mdss_dsi0>;
		qcom,mdss-dsi-panel-type = "dsi_video_mode";
		qcom,mdss-dsi-panel-destination = "display_1";
		qcom,mdss-dsi-panel-framerate = <58>;
		qcom,mdss-dsi-virtual-channel-id = <0>;
		qcom,mdss-dsi-stream = <0>;
		qcom,mdss-dsi-panel-width = <480>;
		qcom,mdss-dsi-panel-height = <854>;
		qcom,mdss-dsi-h-front-porch = <133>;
		qcom,mdss-dsi-h-back-porch = <146>;
		qcom,mdss-dsi-h-pulse-width = <30>;
		qcom,mdss-dsi-h-sync-skew = <0>;
		qcom,mdss-dsi-v-back-porch = <2>;
		qcom,mdss-dsi-v-front-porch = <36>;
		qcom,mdss-dsi-v-pulse-width = <8>;
		qcom,mdss-dsi-h-left-border = <0>;
		qcom,mdss-dsi-h-right-border = <0>;
		qcom,mdss-dsi-v-top-border = <0>;
		qcom,mdss-dsi-v-bottom-border = <0>;
		qcom,mdss-dsi-bpp = <24>;
		qcom,mdss-dsi-color-order = "rgb_swap_rgb";
		qcom,mdss-dsi-underflow-color = <0xff>;
		qcom,mdss-dsi-border-color = <0>;
		qcom,mdss-dsi-on-command = [39 01 00 00 00 00 04 B9 FF 83 79
		39 01 00 00 00 00 0A BA 41 83 A8 4D B2 24 00 00 50
		39 01 00 00 00 00 11 B1 44 19 19 31 31 90 D0 EE 9E 80 38 38 F8 32 22 22
		39 01 00 00 00 00 0A B2 80 FE 0A 07 00 50 11 42 1D 
		39 01 00 00 00 00 0B B4 0D 81 0F 83 01 0F 10 8E 13 8E
		39 01 00 00 00 00 05 C7 00 00 00 C0
		39 01 00 00 00 00 02 CC 02
		39 01 00 00 00 00 02 D2 66 
		39 01 00 00 00 00 24 D3 00 00 00 00 00 04 04 32 10 07 00 07 03 5F 03 5F 00 00 00 00 17 11 07 07 13 07 07 23 08 00 00 00 0A 00 11 
		39 01 00 00 00 00 24 D5 21 20 18 18 01 00 03 02 0F 0E 0D 0C 25 24 18 18 18 18 18 18 18 18 18 18 18 18 18 18 18 18 18 18 00 00 03 
		39 01 00 00 00 00 21 D6 24 25 18 18 00 01 02 03 0C 0D 0E 0F 20 21 18 18 18 18 18 18 18 18 18 18 18 18 18 18 18 18 18 18
		39 01 00 00 00 00 2B E0 00 00 01 35 3D 3F 0E 38 06 09 0B 17 0F 11 13 12 13 07 11 13 18 00 00 02 36 3D 3F 0F 38 05 07 0A 15 0E 11 13 11 13 07 11 12 16
		39 01 00 00 00 00 02 BD 00 
		39 01 00 00 00 00 2C C1 01 00 08 11 18 20 28 2F 37 3F 47 4E 55 5D 64 6B 72 7A 82 8A 92 9B A3 AB B4 BB C3 CC D3 DB E4 ED F6 FF B2 DE C7 07 41 08 40 B0 C0
		39 01 00 00 00 00 02 BD 01 
		39 01 00 00 00 00 2B C1 00 08 10 17 1F 26 2E 35 3D 44 4B 53 59 60 67 6E 76 7D 85 8C 94 9D A5 AD B5 BC C4 CC D3 DB E4 EC F4 AB 75 7C FF 12 C0 00 00 80
		39 01 00 00 00 00 02 BD 02
		39 01 00 00 00 00 2B C1 00 08 10 17 1F 26 2E 34 3D 44 4B 52 59 60 66 6E 75 7C 84 8B 93 9B A3 AB B4 BB C2 CA D1 D9 E2 EA F2 A6 73 11 4C 12 67 01 43 00
		39 01 00 00 00 00 03 B6 5A 5A
		39 01 00 00 00 00 02 E4 00
		39 01 00 00 00 00 02 35 00
		05 01 00 00 96 00 02 11 00
		05 01 00 00 32 00 02 29 00
		39 01 00 00 10 00 03 E4 41 00
		39 01 00 00 10 00 08 E6 40 00 00 05 05 10 18];
		qcom,mdss-dsi-off-command = [05 01 00 00 32 00 02 28 00
					05 01 00 00 78 00 02 10 00];
		qcom,mdss-dsi-on-command-state = "dsi_lp_mode";
		qcom,mdss-dsi-off-command-state = "dsi_hs_mode";
		qcom,mdss-dsi-panel-status-command = [06 01 00 01 05 00 02 09 08];
		qcom,mdss-dsi-panel-status-command-state = "dsi_lp_mode";
		qcom,mdss-dsi-panel-status-check-mode = "reg_read";
		qcom,mdss-dsi-panel-status-value = <0x1C>;
		qcom,mdss-dsi-tx-eot-append;
		qcom,mdss-dsi-h-sync-pulse = <1>;
		qcom,mdss-dsi-traffic-mode = "burst_mode";
		qcom,mdss-dsi-lane-map = "lane_map_3012";
		qcom,mdss-dsi-bllp-eof-power-mode;
		qcom,mdss-dsi-bllp-power-mode;
		qcom,mdss-dsi-hfp-power-mode;
		qcom,mdss-dsi-hbp-power-mode;
		qcom,mdss-dsi-hsa-power-mode;
		qcom,mdss-dsi-lane-0-state;
		qcom,mdss-dsi-lane-1-state;
		qcom,mdss-dsi-lp11-init;		
		qcom,mdss-dsi-panel-timings = [78 24 12 00 40 56 16 24 0E 03 04 00];
		qcom,mdss-dsi-t-clk-post = <0x04>;
		qcom,mdss-dsi-t-clk-pre = <0x1B>;
		qcom,mdss-dsi-bl-min-level = <1>;
		qcom,mdss-dsi-bl-max-level = <255>;
		qcom,mdss-dsi-dma-trigger = "trigger_sw";
		qcom,mdss-dsi-mdp-trigger = "none";
		qcom,mdss-dsi-bl-pmic-control-type = "bl_ctrl_wled";
		qcom,mdss-dsi-reset-sequence = <1 20>, <0 20>, <1 120>;
		qcom,mdss-pan-physical-width-dimension = <55>;
		qcom,mdss-pan-physical-height-dimension = <99>;
	};
};
