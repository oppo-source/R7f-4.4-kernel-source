/* Copyright (c) 2013, The Linux Foundation. All rights reserved.
 *
 * This program is free software; you can redistribute it and/or modify
 * it under the terms of the GNU General Public License version 2 and
 * only version 2 as published by the Free Software Foundation.
 *
 * This program is distributed in the hope that it will be useful,
 * but WITHOUT ANY WARRANTY; without even the implied warranty of
 * MERCHANTABILITY or FITNESS FOR A PARTICULAR PURPOSE.  See the
 * GNU General Public License for more details.
 */

/*---------------------------------------------------------------------------
 * This file is autogenerated file using gcdb parser. Please do not edit it.
 * Update input XML file to add a new entry or update variable in this file
 * VERSION = "1.0"
 *---------------------------------------------------------------------------*/
&mdss_mdp {
	dsi_oppo15025boe_hx8379c_fwvga_video: qcom,mdss_dsi_oppo15025boe_hx8379c_fwvga_video {
		qcom,mdss-dsi-panel-name = "oppo15025boe hx8379c fwvga video mode dsi panel";
		qcom,mdss-dsi-panel-manufacture = "BOE";
		qcom,mdss-dsi-panel-version = "HX8379c";
		qcom,mdss-dsi-panel-controller = <&mdss_dsi0>;
		qcom,mdss-dsi-panel-type = "dsi_video_mode";
		qcom,mdss-dsi-panel-destination = "display_1";
		qcom,mdss-dsi-panel-framerate = <60>;
		qcom,mdss-dsi-virtual-channel-id = <0>;
		qcom,mdss-dsi-stream = <0>;
		qcom,mdss-dsi-panel-width = <480>;
		qcom,mdss-dsi-panel-height = <854>;
		qcom,mdss-dsi-h-front-porch = <159>;
		qcom,mdss-dsi-h-back-porch = <98>;
		qcom,mdss-dsi-h-pulse-width = <10>;
		qcom,mdss-dsi-h-sync-skew = <0>;
		qcom,mdss-dsi-v-back-porch = <3>;
		qcom,mdss-dsi-v-front-porch = <17>;
		qcom,mdss-dsi-v-pulse-width = <8>;
		qcom,mdss-dsi-h-left-border = <0>;
		qcom,mdss-dsi-h-right-border = <0>;
		qcom,mdss-dsi-v-top-border = <0>;
		qcom,mdss-dsi-v-bottom-border = <0>;
		qcom,mdss-dsi-bpp = <24>;
		qcom,mdss-dsi-color-order = "rgb_swap_rgb";
		qcom,mdss-dsi-underflow-color = <0xff>;
		qcom,mdss-dsi-border-color = <0>;
		qcom,mdss-dsi-on-command = [39 01 00 00 00 00 04 B9 FF 83 79
				39 01 00 00 00 00 15 B1 64 19 19 31 31 50 D0 EC 54 80 38 38 F8 22 22 22 00 80 30 00
				39 01 00 00 00 00 0A B2 80 FE 0B 04 00 50 11 42 15
				39 01 00 00 00 00 0B B4 6E 6E 6E 6E 6E 6E 22 86 23 86
				39 01 00 00 00 00 02 CC 02
				39 01 00 00 00 00 02 D2 44
				39 01 00 00 00 00 1E D3 00 07 00 00 00 06 06 32 10 04 00 04 03 6E 03 6E 00 06 00 06 21 22 05 05 23 05 05 23 09
				39 01 00 00 00 00 21 D5 18 18 19 19 01 00 03 02 21 20 18 18 18 18 18 18 18 18 18 18 18 18 18 18 18 18 18 18 18 18 18 18
				39 01 00 00 00 00 21 D6 18 18 18 18 00 01 02 03 20 21 19 19 18 18 18 18 18 18 18 18 18 18 18 18 18 18 18 18 18 18 18 18
				39 01 00 00 00 00 2B E0 00 0A 0F 32 39 3F 20 40 07 0B 0D 17 0F 12 15 13 14 07 11 13 17 00 0A 0F 32 39 3F 20 40 07 0B 0D 17 0F 12 15 13 14 07 11 13 17
				39 01 00 00 00 00 02 BD 00
				39 01 00 00 00 00 2C C1 01 00 0A 16 21 2A 34 3D 46 4E 57 5F 69 70 78 7F 86 8D 95 9D A3 AC B4 B9 C1 C9 CE D5 DC E4 EB F2 F9 FF 7E DE ED AF C7 5C 7B FA C0
				39 01 00 00 00 00 02 BD 01
				39 01 00 00 00 00 2B C1 00 08 15 1D 26 2E 36 3F 46 4D 55 5D 65 6C 73 79 80 87 8C 93 99 A0 A6 AC B3 BA C0 C6 CD D1 D7 DE E4 74 AC B8 57 19 13 D4 7E C0
				39 01 00 00 00 00 02 BD 02
				39 01 00 00 00 00 2B C1 00 0D 16 1F 28 31 3A 43 4A 53 5B 63 6B 72 7A 80 87 8E 94 9B A3 A9 B0 B8 BE C5 CB D1 D9 DF E6 EE F4 52 A8 88 63 8B 78 0B 29 00	
				39 01 00 00 00 00 03 B6 4F 4F
				39 01 00 00 00 00 02 35 00
				05 01 00 00 78 00 02 11 00
				05 01 00 00 32 00 02 29 00];
		qcom,mdss-dsi-off-command = [05 01 00 00 32 00 02 28 00
					05 01 00 00 78 00 02 10 00];
		qcom,mdss-dsi-on-command-state = "dsi_lp_mode";
		qcom,mdss-dsi-off-command-state = "dsi_hs_mode";
		qcom,mdss-dsi-panel-status-command = [06 01 00 01 05 00 02 09 08];
		qcom,mdss-dsi-panel-status-command-state = "dsi_lp_mode";
		qcom,mdss-dsi-panel-status-check-mode = "reg_read";
		qcom,mdss-dsi-panel-status-value = <0x1C>;
		qcom,mdss-dsi-tx-eot-append;
		qcom,mdss-dsi-hfp-power-mode;
		qcom,mdss-dsi-hbp-power-mode;
		qcom,mdss-dsi-hsa-power-mode;
		qcom,mdss-dsi-h-sync-pulse = <1>;
		qcom,mdss-dsi-traffic-mode = "burst_mode";
		qcom,mdss-dsi-lane-map = "lane_map_3012";
		qcom,mdss-dsi-bllp-eof-power-mode;
		qcom,mdss-dsi-bllp-power-mode;
		qcom,mdss-dsi-lane-0-state;
		qcom,mdss-dsi-lane-1-state;
		qcom,mdss-dsi-lp11-init;
		qcom,mdss-dsi-panel-timings = [88 1C 12 00 42 44 18 20 16 03 04 00];
		qcom,mdss-dsi-t-clk-post = <0x04>;
		qcom,mdss-dsi-t-clk-pre = <0x1B>;
		qcom,mdss-dsi-bl-min-level = <1>;
		qcom,mdss-dsi-bl-max-level = <255>;
		qcom,mdss-dsi-dma-trigger = "trigger_sw";
		qcom,mdss-dsi-mdp-trigger = "none";
		qcom,mdss-dsi-bl-pmic-control-type = "bl_ctrl_wled";
		qcom,mdss-dsi-reset-sequence = <1 20>, <0 20>, <1 20>;
		qcom,mdss-pan-physical-width-dimension = <55>;
		qcom,mdss-pan-physical-height-dimension = <99>;
	};
};
