/* Copyright (c) 2013, The Linux Foundation. All rights reserved.
 *
 * This program is free software; you can redistribute it and/or modify
 * it under the terms of the GNU General Public License version 2 and
 * only version 2 as published by the Free Software Foundation.
 *
 * This program is distributed in the hope that it will be useful,
 * but WITHOUT ANY WARRANTY; without even the implied warranty of
 * MERCHANTABILITY or FITNESS FOR A PARTICULAR PURPOSE.  See the
 * GNU General Public License for more details.
 */

/*---------------------------------------------------------------------------
 * This file is autogenerated file using gcdb parser. Please do not edit it.
 * Update input XML file to add a new entry or update variable in this file
 * VERSION = "1.0"
 *---------------------------------------------------------------------------*/
&mdss_mdp {
	dsi_oppo14037tianma_hx8392a_720p_video: qcom,mdss_dsi_oppo14037tianma_hx8392a_720p_video {
		qcom,mdss-dsi-panel-name = "oppo14037tianma 720p video mode dsi panel";
		qcom,mdss-dsi-panel-manufacture = "Tianma";
		qcom,mdss-dsi-panel-version = "HX8392B";
		qcom,mdss-dsi-panel-controller = <&mdss_dsi0>;
		qcom,mdss-dsi-panel-type = "dsi_video_mode";
		qcom,mdss-dsi-panel-destination = "display_1";
		qcom,mdss-dsi-panel-framerate = <60>;
		qcom,mdss-dsi-virtual-channel-id = <0>;
		qcom,mdss-dsi-stream = <0>;
		qcom,mdss-dsi-panel-width = <720>;
		qcom,mdss-dsi-panel-height = <1280>;
		qcom,mdss-dsi-h-front-porch = <76>;
		qcom,mdss-dsi-h-back-porch = <89>;  /* 152->89 228MHz */
		qcom,mdss-dsi-h-pulse-width = <76>;
		qcom,mdss-dsi-h-sync-skew = <0>;
		qcom,mdss-dsi-v-back-porch = <18>;
		qcom,mdss-dsi-v-front-porch = <20>;
		qcom,mdss-dsi-v-pulse-width = <2>;
		qcom,mdss-dsi-h-left-border = <0>;
		qcom,mdss-dsi-h-right-border = <0>;
		qcom,mdss-dsi-v-top-border = <0>;
		qcom,mdss-dsi-v-bottom-border = <0>;
		qcom,mdss-dsi-bpp = <24>;
		qcom,mdss-dsi-color-order = <0>;
		qcom,mdss-dsi-underflow-color = <0xff>;
		qcom,mdss-dsi-border-color = <0>;
		qcom,mdss-dsi-on-command = [39 01 00 00 00 00 04 B9 FF 83 92
			39 01 00 00 00 00 03 BA 43 03
			39 01 00 00 00 00 18 B1 5D 44 44 14 3B 31 55 11 ED CF 2F 4A 0A 43 F0 C0 C0 C0 C0 00 02 16 19
			39 01 00 00 00 00 13 B2 00 00 C8 12 12 72 1A 12 12 1A 1A 02 01 20 04 13 95 48
			39 01 00 00 00 00 29 B4 00 FF 00 3A 04 39 04 39 02 00 03 04 03 0C 02 03 04 01 00 05 34 00 3A 04 39 04 39 02 00 03 04 00 0C 02 03 04 01 00 05 34
			39 01 00 00 00 00 02 CC 08
			39 01 00 00 00 00 29 D3 00 00 01 00 00 00 28 08 32 10 11 00 11 32 13 C0 00 00 32 10 08 00 00 10 12 12 03 04 00 27 00 00 00 0A 00 01 12 05 15 00
			39 01 00 00 00 00 37 D5 00 18 18 01 02 18 18 03 18 18 18 18 18 18 18 18 18 18 18 18 18 18 18 18 18 18 18 18 18 18 18 18 18 18 18 18 1E 1E 20 20 18 18 31 31 30 30 2F 2F 18 18 18 18 18 18
			39 01 00 00 00 00 37 D6 03 18 18 02 01 18 18 00 18 18 18 18 18 18 18 18 18 18 18 18 18 18 18 18 18 18 18 18 18 18 18 18 18 18 18 18 1E 1E 20 20 18 18 31 31 30 30 2F 2F 18 18 18 18 18 18
			39 01 00 00 00 00 02 BD 00
			39 01 00 00 00 00 1D D8 CC 00 00 00 02 EA 00 22 00 00 00 02 EA 00 00 00 00 00 00 00 00 00 00 00 00 00 00 00
			39 01 00 00 00 00 02 BD 01
			39 01 00 00 00 00 2B D8 CC 00 00 00 03 3F 00 33 00 00 00 03 3F 00 00 00 00 00 00 00 00 00 00 00 00 00 00 00 00 00 00 00 00 00 00 00 00 00 00 00 00 00
			39 01 00 00 00 00 02 BD 02
			39 01 00 00 00 00 0F D8 CC 00 00 00 03 3F 00 33 00 00 00 03 3F 00
			39 01 00 00 00 00 02 BD 00
			39 01 00 00 00 00 06 C7 10 06 80 00 44
			39 01 00 00 00 00 2B E0 01 1A 1E 31 36 3D 26 41 07 0D 0E 11 13 12 13 11 18 01 1A 1E 31 36 3D 26 41 07 0D 0E 11 13 12 13 11 18 0B 17 07 12 0B 17 07 12
			
			39 01 00 00 14 00 03 E4 01 01
			/*39 01 00 00 14 00 11 E6 00 00 05 20 00 00 00 08 02 02 08 04 04 20 20 04*/

			39 01 00 00 00 00 02 BD 00
			39 01 00 00 00 00 2C C1 01 00 07 10 18 20 29 31 3A 42 4A 52 5A 62 6A 72 7A 82 8A 92 9A A2 AA B2 BA C1 C9 D1 D9 E1 E9 F1 F9 FF 00 00 00 00 00 00 00 00 00
			39 01 00 00 00 00 02 BD 01
			39 01 00 00 00 00 2B C1 00 06 0C 14 1D 25 2C 32 3A 42 48 4F 57 60 68 6F 77 7E 84 8B 93 9B A3 AA B1 B8 BF C7 CF D7 E0 E7 F0 00 00 00 00 00 00 00 00 00
			39 01 00 00 00 00 02 BD 02
			39 01 00 00 00 00 2B C1 00 06 0C 14 1D 25 2C 32 3A 42 48 4F 57 60 68 6F 77 7E 84 8B 93 9B A3 AA B1 B8 BF C7 CF D7 E0 E7 F0 00 00 00 00 00 00 00 00 00
			39 01 00 00 00 00 02 BD 00
			
			/*secend
			39 01 00 00 00 00 02 BD 00
			39 01 00 00 00 00 2C C1 01 00 07 10 18 20 29 31 3A 42 4A 52 5A 62 6A 72 7A 82 8A 92 9A A2 AA B2 BA C1 C9 D1 D9 E1 E9 F1 F9 FF 00 00 00 00 00 00 00 00 00
			39 01 00 00 00 00 02 BD 01
			39 01 00 00 00 00 2B C1 00 06 0D 15 1E 26 2D 34 3C 44 4A 51 59 62 6A 71 79 80 86 8D 95 9D A5 AC B3 BA C1 C9 D1 D9 E1 E9 F2 00 00 00 00 00 00 00 00 00
			39 01 00 00 00 00 02 BD 02
			39 01 00 00 00 00 2B C1 00 06 0C 14 1D 25 2C 32 3A 42 48 4F 57 60 68 6F 77 7E 84 8B 93 9B A3 AA B1 B8 BF C7 CF D7 E0 E7 F0 00 00 00 00 00 00 00 00 00
			39 01 00 00 00 00 02 BD 00
            */
            /* first
			39 01 00 00 00 00 02 BD 00
			39 01 00 00 00 00 2C C1 01 00 07 10 18 20 29 31 3A 42 4A 52 5A 62 6A 72 7A 82 8A 92 9A A2 AA B2 BA C1 C9 D1 D9 E1 E9 F1 F9 FF 00 00 00 00 00 00 00 00 00
			39 01 00 00 00 00 02 BD 01
			39 01 00 00 00 00 2B C1 00 06 0D 15 1E 26 2D 34 3C 44 4A 51 59 62 6A 71 79 80 86 8D 95 9D A5 AC B3 BA C1 C9 D1 D9 E1 E9 F2 00 00 00 00 00 00 00 00 00
			39 01 00 00 00 00 02 BD 02
			39 01 00 00 00 00 2B C1 00 06 0D 15 1E 26 2D 34 3C 44 4A 51 59 62 6A 71 79 80 86 8D 95 9D A5 AC B3 BA C1 C9 D1 D9 E1 E9 F2 00 00 00 00 00 00 00 00 00
			39 01 00 00 00 00 02 BD 00
			*/
			
			39 01 00 00 78 00 02 11 00
			39 01 00 00 32 00 02 29 00];
		qcom,mdss-dsi-off-command = [05 01 00 00 32 00 02 28 00
					05 01 00 00 78 00 02 10 00];
		qcom,mdss-dsi-on-command-state = "dsi_lp_mode";
		qcom,mdss-dsi-off-command-state = "dsi_hs_mode";
		qcom,mdss-dsi-panel-status-command = [06 01 00 01 05 00 02 09 08];
		qcom,mdss-dsi-panel-status-command-state = "dsi_lp_mode";
		qcom,mdss-dsi-panel-status-check-mode = "reg_read";
		qcom,mdss-dsi-panel-status-value = <0x80>;
		/*qcom,mdss-dsi-tx-eot-append;*/
		qcom,mdss-dsi-h-sync-pulse = <1>;
		qcom,mdss-dsi-traffic-mode = "burst_mode";
		qcom,mdss-dsi-lane-map = <0>;
		qcom,mdss-dsi-bllp-eof-power-mode;
		qcom,mdss-dsi-bllp-power-mode;
		qcom,mdss-dsi-lane-0-state;
		qcom,mdss-dsi-lane-1-state;
		qcom,mdss-dsi-lane-2-state;
		qcom,mdss-dsi-lane-3-state;
		qcom,mdss-dsi-panel-timings = [87 1C 12 00 42 44 18 20 17 03 04 00];
		qcom,mdss-dsi-t-clk-post = <0x04>;
		qcom,mdss-dsi-t-clk-pre = <0x1B>;
		qcom,mdss-dsi-bl-min-level = <1>;
		qcom,mdss-dsi-bl-max-level = <255>;
		qcom,mdss-dsi-reset-sequence = <1 10>, <0 10>, <1 60>;
		qcom,mdss-dsi-dma-trigger = <4>;
		qcom,mdss-dsi-mdp-trigger = <0>;
		qcom,mdss-dsi-bl-pmic-control-type = "bl_ctrl_wled";
		qcom,mdss-pan-physical-width-dimension = <58>;
		qcom,mdss-pan-physical-height-dimension = <103>;		
		qcom,mdss-dsi-lp11-init = <1>;
	};
};
