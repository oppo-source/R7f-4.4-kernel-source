/* Copyright (c) 2013, The Linux Foundation. All rights reserved.
 *
 * This program is free software; you can redistribute it and/or modify
 * it under the terms of the GNU General Public License version 2 and
 * only version 2 as published by the Free Software Foundation.
 *
 * This program is distributed in the hope that it will be useful,
 * but WITHOUT ANY WARRANTY; without even the implied warranty of
 * MERCHANTABILITY or FITNESS FOR A PARTICULAR PURPOSE.  See the
 * GNU General Public License for more details.
 */

/*---------------------------------------------------------------------------
 * This file is autogenerated file using gcdb parser. Please do not edit it.
 * Update input XML file to add a new entry or update variable in this file
 * VERSION = "1.0"
 *---------------------------------------------------------------------------*/
&mdss_mdp {
	dsi_oppo14043tm_nt35512s_fwvga_video: qcom,mdss_dsi_oppo14043tm_nt35512s_fwvga_video {
		qcom,mdss-dsi-panel-name = "oppo14043tm nt35512s fwvga video mode dsi panel";
		qcom,mdss-dsi-panel-manufacture = "Tianma";
		qcom,mdss-dsi-panel-version = "nt35512s";
		qcom,mdss-dsi-panel-controller = <&mdss_dsi0>;
		qcom,mdss-dsi-panel-type = "dsi_video_mode";
		qcom,mdss-dsi-panel-destination = "display_1";
		qcom,mdss-dsi-panel-framerate = <60>;
		qcom,mdss-dsi-virtual-channel-id = <0>;
		qcom,mdss-dsi-stream = <0>;
		qcom,mdss-dsi-panel-width = <480>;
		qcom,mdss-dsi-panel-height = <854>;
		qcom,mdss-dsi-h-front-porch = <59>;
		qcom,mdss-dsi-h-back-porch = <59>;
		qcom,mdss-dsi-h-pulse-width = <10>;
		qcom,mdss-dsi-h-sync-skew = <0>;
		qcom,mdss-dsi-v-back-porch = <2>;
		qcom,mdss-dsi-v-front-porch = <17>;
		qcom,mdss-dsi-v-pulse-width = <8>;
		qcom,mdss-dsi-h-left-border = <0>;
		qcom,mdss-dsi-h-right-border = <0>;
		qcom,mdss-dsi-v-top-border = <0>;
		qcom,mdss-dsi-v-bottom-border = <0>;
		qcom,mdss-dsi-bpp = <24>;
		qcom,mdss-dsi-color-order = "rgb_swap_rgb";
		qcom,mdss-dsi-underflow-color = <0xff>;
		qcom,mdss-dsi-border-color = <0>;
		qcom,mdss-dsi-on-command = [39 01 00 00 00 00 06 F0 55 AA 52 08 02
39 01 00 00 00 00 21 B2 00 01 12 12 04 05 06 07 08 09 0A 12 12 12 12 0F 00 12 12 12 12 05 06 07 08 09 0A 0B 12 12 0E 0F
39 01 00 00 00 00 06 F0 55 AA 52 08 01 
39 01 00 00 00 00 02 B0 0F 
39 01 00 00 00 00 02 B1 0F 
39 01 00 00 00 00 02 B2 00 
39 01 00 00 00 00 02 B3 08
39 01 00 00 00 00 04 B5 08 08 08 
39 01 00 00 00 00 02 B6 24
39 01 00 00 00 00 02 B7 24 
39 01 00 00 00 00 02 B8 24
39 01 00 00 00 00 02 B9 34 
39 01 00 00 00 00 02 BA 14
39 01 00 00 00 00 02 BF 01 
39 01 00 00 00 00 04 BC 00 78 00
39 01 00 00 00 00 04 BD 00 78 00
/*0.295*/
39 01 00 00 00 00 35 D1 00 1D 00 42 00 69 00 8E 00 A3 00 C7 00 E3 01 1A 01 40 01 7E 01 AD 01 F4 02 2E 02 2F 02 65 02 A0 02 C2 02 F2 03 0F 03 31 03 67 03 9E 03 B9 03 D5 03 F1 03 FF
39 01 00 00 00 00 35 D2 01 21 01 26 01 2E 01 38 01 3F 01 4D 01 5A 01 77 01 8E 01 B3 01 D7 02 0F 02 3F 02 41 02 73 02 AA 02 CE 02 FE 03 1D 03 43 03 75 03 A7 03 C0 03 D9 03 F2 03 FF
39 01 00 00 00 00 35 D3 00 F9 00 FF 01 07 01 13 01 1C 01 2B 01 39 01 5A 01 74 01 A0 01 C6 02 03 02 37 02 39 02 6D 02 A5 02 CA 02 FF 03 25 03 8A 03 A9 03 C8 03 D7 03 E7 03 F7 03 FF
39 01 00 00 00 00 35 D4 00 1D 00 42 00 69 00 8E 00 A3 00 C7 00 E3 01 1A 01 40 01 7E 01 AD 01 F4 02 2E 02 2F 02 65 02 A0 02 C2 02 F2 03 0F 03 31 03 67 03 9E 03 B9 03 D5 03 F1 03 FF
39 01 00 00 00 00 35 D5 01 21 01 26 01 2E 01 38 01 3F 01 4D 01 5A 01 77 01 8E 01 B3 01 D7 02 0F 02 3F 02 41 02 73 02 AA 02 CE 02 FE 03 1D 03 43 03 75 03 A7 03 C0 03 D9 03 F2 03 FF
39 01 00 00 00 00 35 D6 00 F9 00 FF 01 07 01 13 01 1C 01 2B 01 39 01 5A 01 74 01 A0 01 C6 02 03 02 37 02 39 02 6D 02 A5 02 CA 02 FF 03 25 03 8A 03 A9 03 C8 03 D7 03 E7 03 F7 03 FF

39 01 00 00 00 00 06 F0 55 AA 52 08 00 

39 01 00 00 00 00 0D D7 20 20 20 3F 00 00 00 00 00 00 00 00
39 01 00 00 00 00 0E D8 00 00 00 00 00 00 00 00 00 00 3F 20 00

39 01 00 00 00 00 03 B1 EC 00 
39 01 00 00 00 00 02 B5 6B
39 01 00 00 00 00 02 B6 05
39 01 00 00 00 00 03 B7 00 00
39 01 00 00 00 00 05 B8 01 07 07 07  
39 01 00 00 00 00 04 BC 00 00 00
39 01 00 00 00 00 0E C9 C0 80 00 E0 00 81 C7 4B 40 04 10 00 00 
39 01 00 00 64 00 02 DE 19 
05 01 00 00 78 00 02 11 00 		
05 01 00 00 32 00 02 29 00];
		qcom,mdss-dsi-off-command = [05 01 00 00 32 00 02 28 00
05 01 00 00 78 00 02 10 00];
		qcom,mdss-dsi-on-command-state = "dsi_lp_mode";
		qcom,mdss-dsi-off-command-state = "dsi_hs_mode";
		qcom,mdss-dsi-panel-status-command = [06 01 00 01 05 00 02 7F 08];
		qcom,mdss-dsi-panel-status-command-state = "dsi_lp_mode";
		qcom,mdss-dsi-panel-status-check-mode = "reg_read";
		qcom,mdss-dsi-panel-status-value = <0x00>;
		qcom,mdss-dsi-tx-eot-append;
		qcom,mdss-dsi-h-sync-pulse = <1>;
		qcom,mdss-dsi-traffic-mode = "burst_mode";
		qcom,mdss-dsi-lane-map = "lane_map_3012";
		qcom,mdss-dsi-bllp-eof-power-mode;
		qcom,mdss-dsi-bllp-power-mode;
		qcom,mdss-dsi-lane-0-state;
		qcom,mdss-dsi-lane-1-state;
		qcom,mdss-dsi-panel-timings = [76 18 10 00 3a 3e 14 1c 12 03 04 00];
		qcom,mdss-dsi-t-clk-post = <0x04>;
		qcom,mdss-dsi-t-clk-pre = <0x19>;
		qcom,mdss-dsi-bl-min-level = <1>;
		qcom,mdss-dsi-bl-max-level = <255>;
		qcom,mdss-dsi-dma-trigger = "trigger_sw";
		qcom,mdss-dsi-mdp-trigger = "none";
		qcom,mdss-dsi-bl-pmic-control-type = "bl_ctrl_wled";
		qcom,mdss-dsi-reset-sequence = <1 20>, <0 20>, <1 20>;
		qcom,mdss-pan-physical-width-dimension = <55>;
		qcom,mdss-pan-physical-height-dimension = <99>;
	};
};
